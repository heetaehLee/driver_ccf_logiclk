## kernel_src/drivers/clk/Kconfig
```kconfig
config COMMON_CLK_LOGICLK
	tristate "logiCLK driver"
	default n
	help
	---help---
	  Support for the Xylon logiCLK IP core clock generator for Xilinx
	  FPGAs
```
